VERSION ""

NS_ :

BS_:

BU_:

BO_ 2348941054 New_Message_2: 5 Vector__XXX
 SG_ New_Signal_5 : 32|8@1+ (0.01,0) [0|0] "amet" Vector__XXX
 SG_ New_Signal_4 : 24|8@1+ (1,0) [0|0] "sit" Vector__XXX
 SG_ New_Signal_3 M : 16|8@1+ (1,0) [0|0] "dolar" Vector__XXX
 SG_ New_Signal_2 m0 : 8|8@1+ (1,0) [0|0] "ipsum" Vector__XXX
 SG_ New_Signal_1 m66 : 0|8@1+ (1,0) [0|0] "lorum" Vector__XXX

BO_ 2348873389 New_Message_1: 8 Vector__XXX
 SG_ New_Signal_1 M : 0|8@1+ (1,0) [0|0] "lorum" Vector__XXX
 SG_ New_Signal_2 m1M : 8|8@1+ (1,0) [0|0] "ipsum" Vector__XXX
 SG_ New_Signal_3 m10M : 16|8@1+ (1,0) [0|0] "dolar" Vector__XXX
 SG_ New_Signal_4 m0 : 24|8@1+ (1,0) [0|0] "sit" Vector__XXX
 SG_ New_Signal_5 m0 : 32|8@1+ (0.01,0) [0|0] "amet" Vector__XXX

BA_DEF_ SG_  "SigType" ENUM  "Default","Range","RangeSigned","ASCII","Discrete","Control","ReferencePGN","DTC","StringDelimiter","StringLength","StringLengthControl","MessageCounter","MessageChecksum";
BA_DEF_ SG_  "GenSigEVName" STRING ;
BA_DEF_ SG_  "GenSigILSupport" ENUM  "No","Yes";
BA_DEF_ SG_  "GenSigSendType" ENUM  "Cyclic","OnWrite","OnWriteWithRepetition","OnChange","OnChangeWithRepetition","IfActive","IfActiveWithRepetition","NoSigSendType";
BA_DEF_ BO_  "GenMsgILSupport" ENUM  "No","Yes";
BA_DEF_ BU_  "NmStationAddress" INT 0 255;
BA_DEF_ BO_  "GenMsgSendType" ENUM  "cyclic","NotUsed","IfActive","NotUsed","NotUsed","NotUsed","NotUsed","NotUsed","noMsgSendType";
BA_DEF_ BO_  "GenMsgRequestable" INT 0 1;
BA_DEF_  "DBName" STRING ;
BA_DEF_  "BusType" STRING ;
BA_DEF_  "ProtocolType" STRING ;
BA_DEF_ BO_  "VFrameFormat" ENUM  "StandardCAN","ExtendedCAN","reserved","J1939PG";
BA_DEF_DEF_  "SigType" "Default";
BA_DEF_DEF_  "GenSigEVName" "Env@Nodename_@Signame";
BA_DEF_DEF_  "GenSigILSupport" "Yes";
BA_DEF_DEF_  "GenSigSendType" "NoSigSendType";
BA_DEF_DEF_  "GenMsgILSupport" "Yes";
BA_DEF_DEF_  "NmStationAddress" 254;
BA_DEF_DEF_  "GenMsgSendType" "noMsgSendType";
BA_DEF_DEF_  "GenMsgRequestable" 1;
BA_DEF_DEF_  "DBName" "";
BA_DEF_DEF_  "BusType" "CAN";
BA_DEF_DEF_  "ProtocolType" "J1939";
BA_DEF_DEF_  "VFrameFormat" "J1939PG";

SG_MUL_VAL_ 2348873389 New_Signal_2 New_Signal_1 1-176;
SG_MUL_VAL_ 2348873389 New_Signal_3 New_Signal_2 10-100;
SG_MUL_VAL_ 2348873389 New_Signal_1 New_Signal_3 10-100;
SG_MUL_VAL_ 2348873389 New_Signal_4 New_Signal_3 0-3;
SG_MUL_VAL_ 2348873389 New_Signal_5 New_Signal_3 0-5;
